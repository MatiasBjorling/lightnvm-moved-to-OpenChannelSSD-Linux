## drivers/md/lightnvm/Kconfig
```kconfig
config LIGHTNVM
	tristate "LightNVM translation layer support (EXPERIMENTAL)"
	depends on BLK_DEV_DM
	---help---
		A target that implements the internals of SSDs within the host.
		The target can be used with LightNVM compatible device or as an
		in-memory store. The device mapper is used together with a
		"bare" firmware. It exposes direct access to the underlying NVM.

		To compile this code as a module, choose M here: the module will
		be called dm-lightnvm.

		If unsure, say N.

config LIGHTNVM_HINTS
	tristate "Various application hints to be used by LightNVM"
	depends on LIGHTNVM
	---help---
		Implements swap, latency and pack hints within the LightNVM layer.

		If unsure, say N.
```

## drivers/nvd/Kconfig
```kconfig
#
# Storage device IO Remapping configuration
#

menuconfig NV_DEV
	bool "Non-volatile storage device I/O remapping support"
	depends on NVM
	default y
	---help---
	  Say Y here to get to see options for various different remapping
	  algorithms for storage devices. This option alone does not add any kernel
	  code.

	  If you say N, all options in this submenu will be skipped and disabled;
	  only do this if you know what you are doing.

if NV_DEV

config NV_DEV_MAP
	tristate "Remapping Support"
	---help---
	  If you want to enable remapping of IOs beneath the block layer and/or
	  direct access from DAX. Say Y.

	  To compile this as a module, choose M here: the
	  module will be called rem.

source "drivers/nvd/lightnvm/Kconfig"

endif # NV_DEV
```

## drivers/nvd/lightnvm/Kconfig
```kconfig
config LIGHTNVM
	tristate "LightNVM translation layer support (EXPERIMENTAL)"
	depends on BLK_DEV_DM
	---help---
		A target that implements the internals of SSDs within the host.
		The target can be used with LightNVM compatible device or as an
		in-memory store. The device mapper is used together with a
		"bare" firmware. It exposes direct access to the underlying NVM.

		To compile this code as a module, choose M here: the module will
		be called dm-lightnvm.

		If unsure, say N.
```

## drivers/rem/Kconfig
```kconfig
#
# Storage device IO Remapping configuration
#

menuconfig REM_DEV
	bool "Storage device I/O remapping support"
	depends on NVM
	default y
	---help---
	  Say Y here to get to see options for various different remapping
	  algorithms for storage devices. This option alone does not add any kernel
	  code.

	  If you say N, all options in this submenu will be skipped and disabled;
	  only do this if you know what you are doing.

if REM_DEV


config REM_DEV
	tristate "Remapping Support"
	---help---
	  If you want to enable remapping of IOs beneath the block layer and or
	  direct access from DAX. Say Y.

	  To compile this as a module, choose M here: the
	  module will be called rem.

endif # REM_DEV
```

## drivers/vsl/Kconfig
```kconfig
#
# Open Virtual Storage Layer (OpenVSL) configuration
#

menuconfig OPENVSL
	bool "Open Virtual Storage Layer support"
	depends on BLK_DEV
	default y
	---help---
	  Say Y here to get to enable OpenVSL devices to be recognized.

	  OpenVSL implements some internals of SSDs within the host.
	  Devices are required to support OpenVSL, and allow it to managed by
	  ghost. OpenVSL is used together with a "bare" firmware, that
	  exposes direct access to the underlying non-volatile memory.

	  If you say N, all options in this submenu will be skipped and disabled;
	  only do this if you know what you are doing.
```
